## boards/shields/keybrick/Kconfig.defconfig
```kconfig
config KEYBRICK_LEFT
    def_bool $(shields_list_contains,keybrick_left)

config KEYBRICK_RIGHT
    def_bool $(shields_list_contains,keybrick_right)
```
